## CMakeLists.txt
```
# WiFi RTP/UDP Receiver for nRF7002-DK
cmake_minimum_required(VERSION 3.20.0)

# Explicitly add nRF7002 WiFi configuration
set(CONF_FILE "prj.conf;nrf7002.conf")

find_package(Zephyr REQUIRED HINTS $ENV{ZEPHYR_BASE})
project(wifi_rtp_receiver LANGUAGES CXX)

# Enable C++17
set_property(TARGET app PROPERTY CXX_STANDARD 17)

# Remove -nostdinc++ to allow STL headers
target_compile_options(app PRIVATE
    $<$<COMPILE_LANGUAGE:CXX>:-U_GLIBCXX_USE_C99>
)

# Explicitly add C++ include paths from toolchain
target_include_directories(app PRIVATE
    $ENV{ZEPHYR_SDK_INSTALL_DIR}/arm-zephyr-eabi/arm-zephyr-eabi/include/c++/12.2.0
    $ENV{ZEPHYR_SDK_INSTALL_DIR}/arm-zephyr-eabi/arm-zephyr-eabi/include/c++/12.2.0/arm-zephyr-eabi
)

# Source files
target_sources(app PRIVATE
    src/main.cpp
    src/net/wifi_mgr.c
    src/net/rtp_receiver.cpp
    src/cli/shell_commands.cpp
)

# Include directories
target_include_directories(app PRIVATE
    src/
    src/net/
    src/cli/
)
```

## Kconfig
```
mainmenu "WiFi RTP Receiver Configuration"

source "Kconfig.zephyr"

menu "WiFi RTP Receiver Settings"

config WIFI_SSID
	string "WiFi SSID"
	default "MyNetwork"
	help
	  WiFi network name to connect to

config WIFI_PSK
	string "WiFi Password"
	default "MyPassword"
	help
	  WiFi network password

config RTP_UDP_PORT
	int "UDP Port for RTP Audio"
	default 5004
	help
	  UDP port to listen for incoming RTP audio packets

endmenu
```

## sysbuild.conf
```
# Sysbuild configuration for audioBle
SB_CONFIG_WIFI_NRF70=y
```

## prj.conf
```kconfig
# WiFi RTP/UDP Receiver Configuration
# Based on Nordic WiFi Shell Sample

# C++ support - Minimal C++ library only
CONFIG_CPP=y
CONFIG_MINIMAL_LIBC=n
CONFIG_NEWLIB_LIBC=y
CONFIG_NEWLIB_LIBC_NANO=n
CONFIG_GLIBCXX_LIBCPP=y

# WiFi
CONFIG_WIFI=y
CONFIG_WIFI_NRF70=y
CONFIG_WIFI_NM_WPA_SUPPLICANT=y
CONFIG_NET_L2_WIFI_SHELL=y
CONFIG_WIFI_MGMT_EXT=y
CONFIG_WIFI_CREDENTIALS=y
CONFIG_WIFI_NM_WPA_SUPPLICANT_LOG_LEVEL_INF=y

# Networking
CONFIG_NETWORKING=y
CONFIG_NET_SOCKETS=y
CONFIG_NET_LOG=y
CONFIG_NET_IPV6=y
CONFIG_NET_IPV4=y
CONFIG_NET_UDP=y
CONFIG_NET_TCP=y
CONFIG_NET_DHCPV4=y
CONFIG_DNS_RESOLVER=y

# Network statistics
CONFIG_NET_STATISTICS=y
CONFIG_NET_STATISTICS_WIFI=y
CONFIG_NET_STATISTICS_USER_API=y

# Network buffers
CONFIG_NET_PKT_RX_COUNT=8
CONFIG_NET_PKT_TX_COUNT=8
CONFIG_NET_BUF_RX_COUNT=16
CONFIG_NET_BUF_TX_COUNT=16
CONFIG_NRF70_RX_NUM_BUFS=16
CONFIG_NRF70_MAX_TX_AGGREGATION=4
CONFIG_NET_TC_TX_COUNT=1

# Network interfaces and contexts
CONFIG_NET_IF_UNICAST_IPV6_ADDR_COUNT=4
CONFIG_NET_IF_MCAST_IPV6_ADDR_COUNT=5
CONFIG_NET_MAX_CONTEXTS=5
CONFIG_NET_CONTEXT_SYNC_RECV=y
CONFIG_NET_L2_ETHERNET=y
CONFIG_NET_SHELL=y

# Network management
CONFIG_NET_MGMT_EVENT_QUEUE_TIMEOUT=5000
CONFIG_NET_SOCKETS_POLL_MAX=12
CONFIG_NET_MGMT_EVENT_QUEUE_SIZE=16

# Network configuration
CONFIG_NET_CONFIG_AUTO_INIT=n
CONFIG_POSIX_API=y

# Memory configuration
CONFIG_HEAP_MEM_POOL_SIZE=100000
CONFIG_HEAP_MEM_POOL_IGNORE_MIN=y
CONFIG_MAIN_STACK_SIZE=5200
CONFIG_SHELL_STACK_SIZE=5200
CONFIG_NET_TX_STACK_SIZE=4096
CONFIG_NET_RX_STACK_SIZE=4096
CONFIG_SYSTEM_WORKQUEUE_STACK_SIZE=2048

# Settings and storage
CONFIG_SETTINGS=y
CONFIG_SETTINGS_NVS=y
CONFIG_NVS=y
CONFIG_FLASH=y
CONFIG_FLASH_PAGE_LAYOUT=y
CONFIG_FLASH_MAP=y

# Shell/CLI support
CONFIG_SHELL=y
CONFIG_SHELL_BACKEND_SERIAL=y
CONFIG_SHELL_PROMPT_UART="wifi-rtp:~$ "
CONFIG_SHELL_CMD_BUFF_SIZE=256
CONFIG_SHELL_GETOPT=y
CONFIG_DEVICE_SHELL=y
CONFIG_SHELL_CMDS_RESIZE=n

# Logging
CONFIG_LOG=y
CONFIG_LOG_MODE_IMMEDIATE=y
CONFIG_PRINTK=y
CONFIG_ASSERT=y
CONFIG_LOG_DEFAULT_LEVEL=3

# Application logging
CONFIG_LOG_PRINTK=y

# Kernel options
CONFIG_INIT_STACKS=y
CONFIG_ENTROPY_GENERATOR=y
CONFIG_STACK_SENTINEL=y
CONFIG_REBOOT=y
CONFIG_POSIX_CLOCK=y
CONFIG_DATE_SHELL=y

# Debugging
CONFIG_DEBUG_COREDUMP=y
CONFIG_DEBUG_COREDUMP_BACKEND_LOGGING=y
CONFIG_DEBUG_COREDUMP_MEMORY_DUMP_MIN=y
```

## nrf7002.conf
```kconfig
# Force enable nRF70 WiFi driver
# This file is a workaround for Kconfig dependency issues
CONFIG_WIFI_NRF70=y
```

## boards/nrf7002dk_nrf5340_cpuapp.conf
```kconfig
# Board-specific WiFi configuration for nRF7002DK
CONFIG_WIFI_NRF70=y
```

## src/main.cpp
```c
#include <zephyr/kernel.h>
#include <zephyr/logging/log.h>
#include <zephyr/sys/printk.h>
#include <zephyr/device.h>
#include <zephyr/net/net_config.h>
#include <zephyr/net/net_if.h>
#include "net/wifi_mgr.h"
#include "net/rtp_receiver.hpp"
#include "cli/shell_commands.hpp"

LOG_MODULE_REGISTER(main, LOG_LEVEL_INF);

int main(void)
{
    // Wait a bit for console to be ready
    k_sleep(K_MSEC(100));
    
    // Use printk to bypass logging system for debugging
    printk("\n\n");
    printk("========================================\n");
    printk("=== MAIN() STARTED - BUILD %s %s ===\n", __DATE__, __TIME__);
    printk("========================================\n");
    printk("If you see this, printk is working!\n");
    printk("========================================\n");
    
    LOG_INF("========================================");
    LOG_INF("=== WiFi RTP Receiver - BUILD %s %s ===", __DATE__, __TIME__);
    LOG_INF("========================================");
    LOG_INF("Board: nRF7002-DK");
    LOG_INF("Firmware compiled: %s at %s", __DATE__, __TIME__);
    
    // Check WiFi driver configuration at compile time
#ifdef CONFIG_WIFI_NRF70
    printk("CONFIG_WIFI_NRF70: ENABLED\n");
    LOG_INF("CONFIG_WIFI_NRF70: ENABLED");
#else
    printk("CONFIG_WIFI_NRF70: DISABLED!!!\n");
    LOG_ERR("CONFIG_WIFI_NRF70: DISABLED!!!");
    LOG_ERR("WiFi driver is NOT compiled in!");
#endif

#ifdef CONFIG_WIFI
    printk("CONFIG_WIFI: ENABLED\n");
    LOG_INF("CONFIG_WIFI: ENABLED");
#else
    printk("CONFIG_WIFI: DISABLED!!!\n");
    LOG_ERR("CONFIG_WIFI: DISABLED!!!");
#endif

#ifdef CONFIG_NETWORKING
    printk("CONFIG_NETWORKING: ENABLED\n");
    LOG_INF("CONFIG_NETWORKING: ENABLED");
#else
    printk("CONFIG_NETWORKING: DISABLED!!!\n");
    LOG_ERR("CONFIG_NETWORKING: DISABLED!!!");
#endif
    
    printk("\n");
    LOG_INF("Use shell commands to control:");
    LOG_INF("  wifi connect -s <ssid> -p <password>  - Connect to WiFi");
    LOG_INF("  wifi scan                             - Scan for networks");
    LOG_INF("  wifi disconnect                       - Disconnect");
    LOG_INF("  rtp start [port]                      - Start RTP receiver");
    LOG_INF("  rtp status                            - Show RTP status");
    LOG_INF("");

    // Initialize network stack - CRITICAL for WiFi to work!
    printk("Initializing network configuration...\n");
#ifdef CONFIG_NET_CONFIG_SETTINGS
    const struct device *dev = DEVICE_DT_GET(DT_CHOSEN(zephyr_wifi));
    if (device_is_ready(dev)) {
        struct net_if *wifi_iface = net_if_lookup_by_dev(dev);
        if (wifi_iface) {
            // Set WiFi as default interface
            net_if_set_default(wifi_iface);
            LOG_INF("WiFi interface set as default");
            
            // Initialize network config (starts DHCP, etc.)
            net_config_init_app(dev, "Initializing network");
            LOG_INF("Network configuration initialized");
            
            // Explicitly bring up the WiFi interface
            if (!net_if_is_up(wifi_iface)) {
                LOG_INF("Bringing up WiFi interface...");
                net_if_up(wifi_iface);
                k_sleep(K_SECONDS(1));
                
                if (net_if_is_up(wifi_iface)) {
                    LOG_INF("WiFi interface is now UP");
                } else {
                    LOG_ERR("Failed to bring up WiFi interface!");
                }
            } else {
                LOG_INF("WiFi interface already UP");
            }
        } else {
            LOG_ERR("Failed to get WiFi network interface!");
        }
    } else {
        LOG_ERR("WiFi device not ready!");
    }
#else
    LOG_WRN("CONFIG_NET_CONFIG_SETTINGS not enabled - network may not work properly");
#endif

    printk("About to create RtpReceiver instance...\n");
    static RtpReceiver* rtpReceiver = nullptr;
    rtpReceiver = new RtpReceiver();
    printk("RtpReceiver created successfully at %p\n", rtpReceiver);
    
    LOG_INF("RtpReceiver created successfully");

    // Initialize shell commands
    printk("Initializing shell commands...\n");
    shell_init(*rtpReceiver);
    printk("Shell commands initialized\n");
    LOG_INF("Shell commands initialized");

    printk("Ready! Type 'help' for available commands\n\n");
    LOG_INF("Ready! Type 'help' for available commands");
    LOG_INF("");

    printk("Entering main loop...\n");
    // Main loop - shell handles commands
    while (1) {
        k_sleep(K_SECONDS(1));
    }

    return 0;
}
```

## src/rtp_receiver.cpp
```c
#include "rtp_receiver.hpp"
#include <zephyr/logging/log.h>
#include <zephyr/net/socket.h>
#include <arpa/inet.h>

LOG_MODULE_REGISTER(rtp_receiver, LOG_LEVEL_DBG);

#define RTP_BUFFER_SIZE 2048
#define RTP_THREAD_STACK_SIZE 2048
#define RTP_THREAD_PRIORITY 7

static K_THREAD_STACK_DEFINE(rtp_thread_stack, RTP_THREAD_STACK_SIZE);
static struct k_thread rtp_thread_data;

int RtpReceiver::parseRtpPacket(const uint8_t* packet, size_t length,
                                 const uint8_t** payload, size_t* payloadLen)
{
    if (length < sizeof(RtpHeader)) {
        LOG_WRN("Packet too small for RTP header");
        return -EINVAL;
    }

    const RtpHeader* header = reinterpret_cast<const RtpHeader*>(packet);
    
    // Extract version (top 2 bits)
    uint8_t version = (header->vpxcc >> 6) & 0x03;
    if (version != 2) {
        LOG_WRN("Invalid RTP version: %u", version);
        return -EINVAL;
    }

    // Extract fields
    uint8_t padding = (header->vpxcc >> 5) & 0x01;
    uint8_t extension = (header->vpxcc >> 4) & 0x01;
    uint8_t csrcCount = header->vpxcc & 0x0F;
    uint8_t payloadType = header->mpt & 0x7F;
    uint16_t sequence = ntohs(header->sequence);
    uint32_t timestamp = ntohl(header->timestamp);

    // Calculate header size
    size_t headerSize = sizeof(RtpHeader) + (csrcCount * 4);
    
    // Handle extension if present
    if (extension) {
        if (length < headerSize + 4) {
            return -EINVAL;
        }
        uint16_t extLen = ntohs(*reinterpret_cast<const uint16_t*>(packet + headerSize + 2));
        headerSize += 4 + (extLen * 4);
    }

    if (headerSize > length) {
        LOG_WRN("Invalid RTP header size");
        return -EINVAL;
    }

    // Extract payload
    *payload = packet + headerSize;
    *payloadLen = length - headerSize;

    // Handle padding
    if (padding && *payloadLen > 0) {
        uint8_t paddingLen = (*payload)[*payloadLen - 1];
        if (paddingLen <= *payloadLen) {
            *payloadLen -= paddingLen;
        }
    }

    LOG_DBG("RTP: seq=%u, ts=%u, pt=%u, payload=%u bytes", 
            sequence, timestamp, payloadType, *payloadLen);

    return 0;
}

void RtpReceiver::receiverThread(void* arg1, void* arg2, void* arg3)
{
    RtpReceiver* receiver = static_cast<RtpReceiver*>(arg1);
    uint8_t buffer[RTP_BUFFER_SIZE];
    
    LOG_INF("RTP receiver thread started");

    while (receiver->m_running) {
        struct sockaddr_in client_addr;
        socklen_t client_addr_len = sizeof(client_addr);

        ssize_t len = recvfrom(receiver->m_socket, buffer, sizeof(buffer), 0,
                               (struct sockaddr*)&client_addr, &client_addr_len);

        if (len < 0) {
            if (errno == EAGAIN || errno == EWOULDBLOCK) {
                k_sleep(K_MSEC(10));
                continue;
            }
            LOG_ERR("recvfrom error: %d", errno);
            k_sleep(K_MSEC(100));
            continue;
        }

        if (len > 0) {
            // Log sender info on first packet or periodically
            char addr_str[INET_ADDRSTRLEN];
            inet_ntop(AF_INET, &client_addr.sin_addr, addr_str, sizeof(addr_str));
            
            const uint8_t* payload;
            size_t payloadLen;
            
            if (receiver->parseRtpPacket(buffer, len, &payload, &payloadLen) == 0) {
                LOG_INF("Received RTP from %s:%u - %u bytes payload",
                        addr_str, ntohs(client_addr.sin_port), payloadLen);
                
                // Here you would forward the payload to audio processing
                // For now, just log it
            }
        }
    }

    LOG_INF("RTP receiver thread stopped");
}

int RtpReceiver::start(uint16_t port)
{
    if (m_running) {
        LOG_WRN("RTP receiver already running");
        return -EALREADY;
    }

    // Create UDP socket
    m_socket = socket(AF_INET, SOCK_DGRAM, IPPROTO_UDP);
    if (m_socket < 0) {
        LOG_ERR("Failed to create socket: %d", errno);
        return -errno;
    }

    // Set socket to non-blocking
    int flags = fcntl(m_socket, F_GETFL, 0);
    fcntl(m_socket, F_SETFL, flags | O_NONBLOCK);

    // Bind to port
    struct sockaddr_in server_addr;
    memset(&server_addr, 0, sizeof(server_addr));
    server_addr.sin_family = AF_INET;
    server_addr.sin_addr.s_addr = INADDR_ANY;
    server_addr.sin_port = htons(port);

    if (bind(m_socket, (struct sockaddr*)&server_addr, sizeof(server_addr)) < 0) {
        LOG_ERR("Failed to bind socket to port %u: %d", port, errno);
        close(m_socket);
        m_socket = -1;
        return -errno;
    }

    LOG_INF("UDP socket bound to port %u", port);

    // Start receiver thread
    m_running = true;
    m_thread_id = k_thread_create(&rtp_thread_data, rtp_thread_stack,
                                   K_THREAD_STACK_SIZEOF(rtp_thread_stack),
                                   receiverThread,
                                   this, NULL, NULL,
                                   RTP_THREAD_PRIORITY, 0, K_NO_WAIT);

    k_thread_name_set(m_thread_id, "rtp_receiver");

    LOG_INF("RTP receiver started on port %u", port);
    return 0;
}

void RtpReceiver::stop()
{
    if (!m_running) {
        return;
    }

    m_running = false;

    // Wait for thread to finish
    if (m_thread_id) {
        k_thread_join(m_thread_id, K_FOREVER);
        m_thread_id = nullptr;
    }

    if (m_socket >= 0) {
        close(m_socket);
        m_socket = -1;
    }

    LOG_INF("RTP receiver stopped");
}
```

## src/rtp_receiver.hpp
```c
#pragma once

#include <zephyr/kernel.h>
#include <cstdint>
#include <cstddef>

// RTP Header structure (RFC 3550)
struct RtpHeader {
    uint8_t vpxcc;      // Version, Padding, Extension, CSRC count
    uint8_t mpt;        // Marker, Payload type
    uint16_t sequence;  // Sequence number
    uint32_t timestamp; // Timestamp
    uint32_t ssrc;      // Synchronization source identifier
};

class RtpReceiver {
public:
    RtpReceiver() = default;
    ~RtpReceiver() = default;

    /**
     * @brief Start UDP server to receive RTP packets
     * @param port UDP port to listen on
     * @return 0 on success, negative error code on failure
     */
    int start(uint16_t port);

    /**
     * @brief Stop the RTP receiver
     */
    void stop();

    /**
     * @brief Check if receiver is running
     */
    bool isRunning() const { return m_running; }

private:
    /**
     * @brief Parse RTP packet and extract payload
     * @param packet Raw packet data
     * @param length Packet length
     * @param payload Output pointer to payload data
     * @param payloadLen Output payload length
     * @return 0 on success, negative error code on failure
     */
    int parseRtpPacket(const uint8_t* packet, size_t length,
                       const uint8_t** payload, size_t* payloadLen);

    /**
     * @brief Background thread function for receiving packets
     */
    static void receiverThread(void* arg1, void* arg2, void* arg3);

    int m_socket = -1;
    bool m_running = false;
    k_tid_t m_thread_id = nullptr;
};
```

## src/shell_commands.cpp
```c
#include "shell_commands.hpp"
#include <zephyr/shell/shell.h>
#include <zephyr/logging/log.h>

LOG_MODULE_REGISTER(shell_cmds, LOG_LEVEL_INF);

// Global references to managers (set during init)
static WiFiManager* g_wifi = nullptr;
static RtpReceiver* g_rtp = nullptr;

// WiFi connect command
static int cmd_wifi_connect(const struct shell *sh, size_t argc, char **argv)
{
    if (argc < 3) {
        shell_error(sh, "Usage: wifi connect <ssid> <password>");
        return -EINVAL;
    }

    if (!g_wifi) {
        shell_error(sh, "WiFi manager not initialized");
        return -ENODEV;
    }

    const std::string ssid = argv[1];
    const std::string password = argv[2];

    shell_print(sh, "Connecting to WiFi: %s", ssid.c_str());
    
    int ret = g_wifi->connect(ssid, password);
    if (ret < 0) {
        shell_error(sh, "WiFi connection failed: %d", ret);
        return ret;
    }

    shell_print(sh, "WiFi connected!");
    shell_print(sh, "IP Address: %s", g_wifi->getIpAddress().c_str());
    
    return 0;
}

// WiFi disconnect command
static int cmd_wifi_disconnect(const struct shell *sh, size_t argc, char **argv)
{
    if (!g_wifi) {
        shell_error(sh, "WiFi manager not initialized");
        return -ENODEV;
    }

    g_wifi->disconnect();
    shell_print(sh, "WiFi disconnected");
    
    return 0;
}

// WiFi status command
static int cmd_wifi_status(const struct shell *sh, size_t argc, char **argv)
{
    if (!g_wifi) {
        shell_error(sh, "WiFi manager not initialized");
        return -ENODEV;
    }

    if (g_wifi->isConnected()) {
        shell_print(sh, "WiFi Status: Connected");
        shell_print(sh, "IP Address: %s", g_wifi->getIpAddress().c_str());
    } else {
        shell_print(sh, "WiFi Status: Disconnected");
    }
    
    return 0;
}

// RTP start command
static int cmd_rtp_start(const struct shell *sh, size_t argc, char **argv)
{
    if (!g_rtp) {
        shell_error(sh, "RTP receiver not initialized");
        return -ENODEV;
    }

    if (!g_wifi || !g_wifi->isConnected()) {
        shell_error(sh, "WiFi must be connected first");
        return -ENOTCONN;
    }

    uint16_t port = CONFIG_RTP_UDP_PORT;
    
    // Optional port argument
    if (argc > 1) {
        port = static_cast<uint16_t>(atoi(argv[1]));
    }

    if (g_rtp->isRunning()) {
        shell_warn(sh, "RTP receiver already running on port %u", g_rtp->getPort());
        return 0;
    }

    shell_print(sh, "Starting RTP receiver on port %u...", port);
    
    int ret = g_rtp->start(port);
    if (ret < 0) {
        shell_error(sh, "Failed to start RTP receiver: %d", ret);
        return ret;
    }

    shell_print(sh, "RTP receiver started!");
    shell_print(sh, "Listening on: %s:%u", g_wifi->getIpAddress().c_str(), port);
    shell_print(sh, "");
    shell_print(sh, "Stream audio with:");
    shell_print(sh, "  python3 stream_audio.py song.mp3 %s %u", 
                g_wifi->getIpAddress().c_str(), port);
    
    return 0;
}

// RTP stop command
static int cmd_rtp_stop(const struct shell *sh, size_t argc, char **argv)
{
    if (!g_rtp) {
        shell_error(sh, "RTP receiver not initialized");
        return -ENODEV;
    }

    if (!g_rtp->isRunning()) {
        shell_warn(sh, "RTP receiver is not running");
        return 0;
    }

    shell_print(sh, "Stopping RTP receiver...");
    g_rtp->stop();
    shell_print(sh, "RTP receiver stopped");
    
    return 0;
}

// RTP status command
static int cmd_rtp_status(const struct shell *sh, size_t argc, char **argv)
{
    if (!g_rtp) {
        shell_error(sh, "RTP receiver not initialized");
        return -ENODEV;
    }

    if (g_rtp->isRunning()) {
        shell_print(sh, "RTP Receiver: Running");
        shell_print(sh, "Port: %u", g_rtp->getPort());
        if (g_wifi && g_wifi->isConnected()) {
            shell_print(sh, "Address: %s:%u", 
                       g_wifi->getIpAddress().c_str(), g_rtp->getPort());
        }
    } else {
        shell_print(sh, "RTP Receiver: Stopped");
    }
    
    return 0;
}

// Define WiFi subcommands
SHELL_STATIC_SUBCMD_SET_CREATE(wifi_cmds,
    SHELL_CMD_ARG(connect, NULL, 
                  "Connect to WiFi network\n"
                  "Usage: wifi connect <ssid> <password>", 
                  cmd_wifi_connect, 3, 0),
    SHELL_CMD_ARG(disconnect, NULL, 
                  "Disconnect from WiFi", 
                  cmd_wifi_disconnect, 1, 0),
    SHELL_CMD_ARG(status, NULL, 
                  "Show WiFi connection status", 
                  cmd_wifi_status, 1, 0),
    SHELL_SUBCMD_SET_END
);

// Define RTP subcommands
SHELL_STATIC_SUBCMD_SET_CREATE(rtp_cmds,
    SHELL_CMD_ARG(start, NULL, 
                  "Start RTP receiver\n"
                  "Usage: rtp start [port]\n"
                  "  port - UDP port (default: 5004)", 
                  cmd_rtp_start, 1, 1),
    SHELL_CMD_ARG(stop, NULL, 
                  "Stop RTP receiver", 
                  cmd_rtp_stop, 1, 0),
    SHELL_CMD_ARG(status, NULL, 
                  "Show RTP receiver status", 
                  cmd_rtp_status, 1, 0),
    SHELL_SUBCMD_SET_END
);

// Register root commands
SHELL_CMD_REGISTER(wifi, &wifi_cmds, "WiFi management commands", NULL);
SHELL_CMD_REGISTER(rtp, &rtp_cmds, "RTP receiver commands", NULL);

void shell_init(WiFiManager& wifi, RtpReceiver& rtp)
{
    g_wifi = &wifi;
    g_rtp = &rtp;
    LOG_INF("Shell commands initialized");
}
```

## src/shell_commands.hpp
```c
#pragma once

#include "wifi_manager.hpp"
#include "rtp_receiver.hpp"

/**
 * @brief Initialize shell commands for WiFi and RTP control
 * @param wifi Reference to WiFiManager instance
 * @param rtp Reference to RtpReceiver instance
 */
void shell_init(WiFiManager& wifi, RtpReceiver& rtp);
```

## src/wifi_manager.cpp
```c
#include "wifi_manager.hpp"
#include <zephyr/logging/log.h>
#include <zephyr/net/wifi_mgmt.h>
#include <zephyr/net/net_event.h>
#include <zephyr/net/socket.h>
#include <cstring>

LOG_MODULE_REGISTER(wifi_manager, LOG_LEVEL_DBG);

static K_SEM_DEFINE(wifi_connected_sem, 0, 1);
static K_SEM_DEFINE(ipv4_obtained_sem, 0, 1);

static void wifi_event_handler(struct net_mgmt_event_callback *cb,
                                uint32_t event, struct net_if *iface)
{
    switch (event) {
    case NET_EVENT_WIFI_CONNECT_RESULT:
        LOG_INF("WiFi connected successfully");
        k_sem_give(&wifi_connected_sem);
        break;
    case NET_EVENT_WIFI_DISCONNECT_RESULT:
        LOG_WRN("WiFi disconnected");
        k_sem_reset(&wifi_connected_sem);
        k_sem_reset(&ipv4_obtained_sem);
        break;
    default:
        break;
    }
}

static void ipv4_event_handler(struct net_mgmt_event_callback *cb,
                                uint32_t event, struct net_if *iface)
{
    if (event == NET_EVENT_IPV4_ADDR_ADD) {
        char addr_str[NET_IPV4_ADDR_LEN];
        
        if (iface->config.ip.ipv4) {
            const struct in_addr *addr = &iface->config.ip.ipv4->unicast[0].address.in_addr;
            inet_ntop(AF_INET, addr, addr_str, sizeof(addr_str));
            LOG_INF("IPv4 address obtained: %s", addr_str);
            k_sem_give(&ipv4_obtained_sem);
        }
    }
}

static struct net_mgmt_event_callback wifi_cb;
static struct net_mgmt_event_callback ipv4_cb;

int WiFiManager::connect()
{
    m_iface = net_if_get_default();
    if (!m_iface) {
        LOG_ERR("No default network interface found");
        return -ENODEV;
    }

    // Setup event callbacks
    net_mgmt_init_event_callback(&wifi_cb, wifi_event_handler,
                                 NET_EVENT_WIFI_CONNECT_RESULT |
                                 NET_EVENT_WIFI_DISCONNECT_RESULT);
    net_mgmt_add_event_callback(&wifi_cb);

    net_mgmt_init_event_callback(&ipv4_cb, ipv4_event_handler,
                                 NET_EVENT_IPV4_ADDR_ADD);
    net_mgmt_add_event_callback(&ipv4_cb);

    // Configure WiFi parameters
    struct wifi_connect_req_params params = {0};
    params.ssid = CONFIG_WIFI_SSID;
    params.ssid_length = strlen(CONFIG_WIFI_SSID);
    params.psk = CONFIG_WIFI_PSK;
    params.psk_length = strlen(CONFIG_WIFI_PSK);
    params.channel = WIFI_CHANNEL_ANY;
    params.security = WIFI_SECURITY_TYPE_PSK;
    params.band = WIFI_FREQ_BAND_2_4_GHZ;
    params.mfp = WIFI_MFP_OPTIONAL;

    LOG_INF("Connecting to WiFi SSID: %s", params.ssid);

    // Request connection
    int ret = net_mgmt(NET_REQUEST_WIFI_CONNECT, m_iface, &params,
                       sizeof(struct wifi_connect_req_params));
    if (ret) {
        LOG_ERR("WiFi connection request failed: %d", ret);
        return ret;
    }

    // Wait for connection (30 second timeout)
    if (k_sem_take(&wifi_connected_sem, K_SECONDS(30)) != 0) {
        LOG_ERR("WiFi connection timeout");
        return -ETIMEDOUT;
    }

    // Wait for IPv4 address (30 second timeout)
    if (k_sem_take(&ipv4_obtained_sem, K_SECONDS(30)) != 0) {
        LOG_ERR("IPv4 address timeout");
        return -ETIMEDOUT;
    }

    m_connected = true;
    LOG_INF("WiFi initialization complete");
    return 0;
}

bool WiFiManager::isConnected() const
{
    return m_connected;
}

int WiFiManager::getIpAddress(char* buffer, size_t size) const
{
    if (!m_iface || !m_iface->config.ip.ipv4) {
        return -EINVAL;
    }

    const struct in_addr *addr = &m_iface->config.ip.ipv4->unicast[0].address.in_addr;
    inet_ntop(AF_INET, addr, buffer, size);
    return 0;
}
```

## src/wifi_manager.hpp
```c
#pragma once

#include <zephyr/kernel.h>
#include <zephyr/net/net_if.h>

class WiFiManager {
public:
    WiFiManager() = default;
    ~WiFiManager() = default;

    /**
     * @brief Initialize and connect to WiFi network
     * @return 0 on success, negative error code on failure
     */
    int connect();

    /**
     * @brief Check if WiFi is connected
     * @return true if connected, false otherwise
     */
    bool isConnected() const;

    /**
     * @brief Get the current IP address
     * @param buffer Buffer to store IP address string
     * @param size Size of buffer
     * @return 0 on success, negative error code on failure
     */
    int getIpAddress(char* buffer, size_t size) const;

private:
    bool m_connected = false;
    struct net_if* m_iface = nullptr;
};
```
